#include "arduino_secrets.h"
// Include Libaries: 
#include "thingProperties.h"
#include <Wire.h>
#include <Adafruit_GFX.h>
#include <Adafruit_SSD1306.h>



// Define Constants:
// Define the display dimension in pixels 
#define SCREEN_WIDTH 128 // OLED display width, in pixels
#define SCREEN_HEIGHT 64 // OLED display height, in pixels

// Define the opening picture dimension in pixels 
#define OPENING_WIDTH 128 // OLED display width, in pixels
#define OPENING_HEIGHT 64 // OLED display height, in pixels

// Define the constants for scrolling 
#define MIN_SCROLL_LINES 7.5 // Minimum value to scroll the text
#define MAX_SCROLL_LINES 4  // Maximum scroll height (in lines)
#define SCROLL_DELAY 1500 // Delay between scroll steps



// Define Global Variables:
// Declaration for an SSD1306 display connected to I2C (SDA, SCL pins)
Adafruit_SSD1306 display(SCREEN_WIDTH, SCREEN_HEIGHT, &Wire, -1);

// Declaration of pins 
int photo_pin = A0; // Photoresistor analog pin
int LED_pin = 2; // LED digital pin

int value; // Lux value obtained by photoresistor

// Declaration of the opening image, in bit map 
const unsigned char opening_bmp [] PROGMEM = {
	0x00, 0x00, 0x00, 0x00, 0x00, 0x00, 0x00, 0x00, 0x00, 0x00, 0x00, 0x00, 0x00, 0x00, 0x00, 0x00, 
	0x00, 0x00, 0x00, 0x00, 0x00, 0x00, 0x00, 0x00, 0x00, 0x00, 0x00, 0x00, 0x00, 0x00, 0x00, 0x00, 
	0x00, 0x00, 0x00, 0x00, 0x00, 0x00, 0x00, 0x00, 0x00, 0x00, 0x00, 0x00, 0x00, 0x00, 0x00, 0x00, 
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	0x00, 0x00, 0x00, 0x00, 0x00, 0x00, 0x00, 0x00, 0x00, 0x00, 0x00, 0x00, 0x00, 0x00, 0x00, 0x00
};

int scrollLine = 0; // Declaration of the number of scroll line



// Initialization 
void setup() {
  Serial.begin(9600);
  delay(1500);

  initProperties();
  ArduinoCloud.begin(ArduinoIoTPreferredConnection);

  setDebugMessageLevel(2);
  ArduinoCloud.printDebugInfo();
  pinMode(LED_pin, OUTPUT);
  pinMode(photo_pin, INPUT);
  
  if(!display.begin(SSD1306_SWITCHCAPVCC, 0x3C)) { // Address 0x3D for 128x64
    Serial.println(F("SSD1306 allocation failed"));
    for(;;);
  }
  
  display.display(); // Display an empty buffer to clear the display
  
  // Clear the display buffer
  display.clearDisplay();
  delay(1000);
  
  // Display the opening image
  display.drawBitmap(0, 0, opening_bmp, SCREEN_WIDTH, SCREEN_HEIGHT, SSD1306_WHITE);
  display.display();
}



// Main Loop
void loop() {
  ArduinoCloud.update();

  // Calculate the width of the current message
  double messageLines = message.length() * 12.0 / display.height();
  int message_Lines = ceil(message.length() * 12.0 / display.height());

  // Display the opening image after the message "seen" (when there is no new message)
  if (message == "seen") {
    display.clearDisplay();
    display.drawBitmap(0, 0, opening_bmp, SCREEN_WIDTH, SCREEN_HEIGHT, SSD1306_WHITE);
    display.display();
  }
  
  // When a new message is coming in
  else {
    display.clearDisplay();
    
    // Check if the text is too long that cannot fit into one screen
    if (messageLines > MIN_SCROLL_LINES) {
      for (int line = 0; line < MAX_SCROLL_LINES; line++) {
        int displayLine = (scrollLine + line) % message_Lines;
        int charIndex = displayLine * (display.width() / 12);
        if (charIndex >= 0 && charIndex < message.length()) {
          display.setTextSize(2);
          display.setTextColor(SSD1306_WHITE);
          display.setCursor(0, line * 16);
          display.println(message.substring(charIndex, charIndex + display.width() / 3));
        }
      }
      
      display.display();
      
      // Increment the scroll line for the next loop iteration
      scrollLine++;
      if (scrollLine >= messageLines) {
        scrollLine = 0; // Reset the scroll line
        delay(SCROLL_DELAY); // Pause before scrolling again
      } else {
        delay(SCROLL_DELAY);
      }
    } else {
      // Display the message without scrolling
      display.setTextSize(2);
      display.setTextColor(SSD1306_WHITE);
      display.setCursor(0, 0);
      display.println(message);
      display.display();
    }
  }
  
  value = analogRead(photo_pin);
  
  // The photoresistor is covered, LED will be turn on and message = seen
  if (value < 5) {
    digitalWrite(LED_pin, LOW);
    delay(10000); 
    message = "seen";
    Serial.println("seen"); 
  } else {
    // The photoresistor is uncovered, LED will be turn off
    digitalWrite(LED_pin, HIGH);
  }
  
  Serial.println(value);
  delay(100);
}



// Functions: 
void onMessageChange() {
  Serial.println(message);
}

void testdrawbitmap(void) {
  display.clearDisplay();

  display.drawBitmap(
    (display.width()  - OPENING_WIDTH ) / 2,
    (display.height() - OPENING_HEIGHT) / 2,
    opening_bmp, OPENING_WIDTH, OPENING_HEIGHT, 1);
  display.display();
  delay(1000);
}